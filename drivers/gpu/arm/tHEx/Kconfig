## drivers/gpu/arm/tHEx/Kconfig
```kconfig
#
# (C) COPYRIGHT 2012-2013 ARM Limited. All rights reserved.
#
# This program is free software and is provided to you under the terms of the
# GNU General Public License version 2 as published by the Free Software
# Foundation, and any use by you of this program is subject to the terms
# of such GNU licence.
#
# A copy of the licence is included with the program, and can also be obtained
# from Free Software Foundation, Inc., 51 Franklin Street, Fifth Floor,
# Boston, MA  02110-1301, USA.
#
#


menuconfig MALI_THEX
	tristate "Mali-THEX support"
	default n
	help
	  Enable this option to build support for the ARM Mali-G72 GPU.

	  To compile this driver as a module, choose M here:
	  this will generate a single module, called mali_kbase.

choice
	prompt "version Configuration"
	depends on MALI_THEX
	default MALI_BIFROST_R19P0_Q
	help
	  Select the gpu support version.

config MALI_BIFROST_R19P0_Q
	depends on MALI_THEX
	bool "Bifrost r19p0 driver for Android Q"

endchoice

if MALI_BIFROST_R19P0_Q
source "drivers/gpu/arm/b_r19p0/Kconfig"
endif
```

## drivers/gud/Kconfig
```kconfig
#
# Mobicore Configuration
#

if SOC_EXYNOS9810
source "drivers/gud/gud-exynos9810/Kconfig"
endif
```
